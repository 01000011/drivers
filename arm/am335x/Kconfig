## arm/am335x/Kconfig
```kconfig
#
# Misc strange devices
#

menu "Misc devices"

config TMP006_I2C
        tristate "Infrared Thermopile Sensor on I2C"
        select TMP006 
        select REGMAP_I2C
        depends on I2C && SYSFS
        help
          Say Y here if you want to support Infrared Thermopile Sensor
          sensor hooked to an I2C bus.

          To compile this driver as a module, choose M here: the
          module will be called tmp006-i2c.


source "drivers/misc/c2port/Kconfig"
source "drivers/misc/eeprom/Kconfig"
source "drivers/misc/cb710/Kconfig"
source "drivers/misc/ti-st/Kconfig"
source "drivers/misc/lis3lv02d/Kconfig"
source "drivers/misc/carma/Kconfig"
source "drivers/misc/altera-stapl/Kconfig"
source "drivers/misc/mei/Kconfig"
source "drivers/misc/cape/Kconfig"

endmenu
```
